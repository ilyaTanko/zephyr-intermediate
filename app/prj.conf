## CMakeLists.txt
```
cmake_minimum_required(VERSION 3.20.0)

find_program(CCACHE_PROGRAM ccache)
if(CCACHE_PROGRAM)
    set(ENV{CCACHE_BASEDIR} "${CMAKE_SOURCE_DIR}")
    set(ENV{CCACHE_DIR} "${CMAKE_SOURCE_DIR}/../.cache/ccache")
    set(CMAKE_C_COMPILER_LAUNCHER "${CCACHE_PROGRAM}")
    set(CMAKE_CXX_COMPILER_LAUNCHER "${CCACHE_PROGRAM}")
endif()

find_package(Zephyr REQUIRED)
project(my_zephyr_app)

target_sources(app PRIVATE
    src/main.c
    src/parser.c
    src/credentials.c
)
```

## prj.conf
```kconfig
CONFIG_LOG=y
CONFIG_LOG_BACKEND_UART=n
CONFIG_LOG_DEFAULT_LEVEL=3
CONFIG_LOG_MAX_LEVEL=3
CONFIG_LOG_MODE_DEFERRED=y
CONFIG_LOG_RATELIMIT=y
CONFIG_LOG_RATELIMIT_INTERVAL_MS=1000
CONFIG_KERNEL_LOG_LEVEL_WRN=y

CONFIG_SERIAL=y
CONFIG_CONSOLE=y
CONFIG_UART_CONSOLE=y
CONFIG_STDOUT_CONSOLE=n
CONFIG_BOOT_BANNER=n
CONFIG_NCS_BOOT_BANNER=n
CONFIG_LOG_PRINTK=n

CONFIG_THREAD_NAME=y
CONFIG_THREAD_MONITOR=y

CONFIG_SHELL=y
CONFIG_KERNEL_SHELL=y
CONFIG_USE_SEGGER_RTT=y
CONFIG_SHELL_BACKEND_SERIAL=n
CONFIG_SHELL_BACKEND_RTT=y
CONFIG_SHELL_LOG_BACKEND=y

CONFIG_ASSERT=y
CONFIG_ZBUS=y
CONFIG_ZBUS_MSG_SUBSCRIBER=y
CONFIG_ZBUS_MSG_SUBSCRIBER_NET_BUF_POOL_SIZE=14

CONFIG_THREAD_ANALYZER=y
CONFIG_THREAD_ANALYZER_USE_LOG=y
CONFIG_MAIN_STACK_SIZE=2048

CONFIG_WATCHDOG=y
CONFIG_TASK_WDT=y
CONFIG_TASK_WDT_HW_FALLBACK=y

CONFIG_FAULT_DUMP=2
CONFIG_EXTRA_EXCEPTION_INFO=y

CONFIG_INIT_STACKS=y
CONFIG_THREAD_STACK_INFO=y
CONFIG_USERSPACE=y

CONFIG_TRACING=y
CONFIG_TRACING_CTF=y
CONFIG_TRACING_ASYNC=y
CONFIG_TRACING_BACKEND_RAM=n
CONFIG_TRACING_BACKEND_UART=y
CONFIG_TRACING_BUFFER_SIZE=8192
CONFIG_TRACING_PACKET_MAX_SIZE=64
```

## src/main.c
```c
#include <zephyr/kernel.h>
#include <zephyr/logging/log.h>
#include <stdio.h>
#include <string.h>
#include "credentials.h"
#include "parser.h"

LOG_MODULE_REGISTER(app, LOG_LEVEL_INF);

#define PARSER_STACK_SIZE 2048

K_THREAD_STACK_DEFINE(parser_stack, PARSER_STACK_SIZE);
static struct k_thread parser_thread;

// Parser thread: receives three packets and parses them.
// The first is a normal command,
// the other two are an attacker's commands, each reading 16 bytes of the key.
static void parser_entry(void* attack_index, void* p2, void* p3) {
	// On this thread's stack, so the parser can always access them.
	char packets[3][32];

	strcpy(packets[0], "get=0");
	snprintf(packets[1], sizeof(packets[1]), "get=%ld", (long)attack_index);
	snprintf(packets[2], sizeof(packets[2]), "get=%ld", (long)attack_index + 1);

	for (int i = 0; i < ARRAY_SIZE(packets); i++) {
		LOG_INF("parser: received '%s'", packets[i]);
		parse_command(packets[i]);
	}
}

// Starts the parser thread.
int main() {
	// The attacker would compute this index from the firmware's ELF file.
	long attack_index = ((const char*)credentials_key_addr() - (const char*)parser_settings_addr()) / SETTING_SIZE;

	k_thread_create(&parser_thread, parser_stack, PARSER_STACK_SIZE,
        parser_entry, (void*)attack_index, NULL, NULL, 5, K_USER, K_NO_WAIT);
	return 0;
}
```

## src/credentials.c
```c
#include <zephyr/toolchain.h>
#include "credentials.h"

/*
 * Not const: a const array goes to flash, which user threads can read.
 * Aligned like the settings table entries, so the key sits at a whole entry index.
 */
static char device_key[32] __aligned(16) = "EC-PRIVATE-KEY:8f3a91c25d7e04b6";

// Only used by main to simulate an attacker who knows the key's address.
const void* credentials_key_addr() {
	return device_key;
}
```

## src/credentials.h
```c
#ifndef CREDENTIALS_H
#define CREDENTIALS_H

// Returns the address of the stored device key.
const void* credentials_key_addr(void);

#endif
```

## src/main_l5.c
```c
#include <zephyr/kernel.h>
#include <zephyr/logging/log.h>
#include <zephyr/sys/sflist.h>
#include <zephyr/zbus/zbus.h>
#include <zephyr/task_wdt/task_wdt.h>

#include <math.h>

LOG_MODULE_REGISTER(demo, LOG_LEVEL_DBG);

#define STACK_SIZE 2048
#define SENSOR_COUNT 18
#define SENSOR_PERIOD_MS 100
#define LOGGER_PERIOD_MS 200
#define LOGGER_WDT_PERIOD_MS 1200
#define LOGGER_STALL_AFTER_RECEIVED 5
#define LOGGER_STALL_MS 1000
#define HEALTHCHECK_PERIOD_MS 250
#define HEALTHCHECK_WARNING_THRESHOLD_PERCENT 75

struct vector3 {
    int32_t x;
    int32_t y;
    int32_t z;
};

struct sensor_data {
    struct vector3 acceleration_mms2;
    uint32_t timestamp_ms;
    uint8_t seq;
};

struct motion_state {
    struct vector3 position_mm;
    struct vector3 velocity_mms;
    uint32_t timestamp_ms;
    bool initialized;
};

static uint32_t vector_magnitude(struct vector3 const* vector) {
    int64_t squared = (int64_t)vector->x * vector->x +
                      (int64_t)vector->y * vector->y +
                      (int64_t)vector->z * vector->z;

    return (uint32_t)sqrt((double)squared);
}

static struct vector3 integrate_motion(struct motion_state* state,
                                       struct vector3 const* acceleration,
                                       uint32_t timestamp_ms) {
    struct vector3 displacement_mm = {0, 0, 0};

    if (!state->initialized) {
        state->timestamp_ms = timestamp_ms;
        state->initialized = true;
        return displacement_mm;
    }

    uint32_t elapsed_ms = timestamp_ms - state->timestamp_ms;
    int64_t elapsed_squared = (int64_t)elapsed_ms * elapsed_ms;
    int32_t* displacement_axes = &displacement_mm.x;
    int32_t* position_axes = &state->position_mm.x;
    int32_t* velocity_axes = &state->velocity_mms.x;
    int32_t const* acceleration_axes = &acceleration->x;

    for (int axis = 0; axis < 3; axis++) {
        displacement_axes[axis] = (int32_t)((int64_t)velocity_axes[axis] * elapsed_ms / 1000 +
                                            (int64_t)acceleration_axes[axis] * elapsed_squared /
                                                2000000);
        position_axes[axis] += displacement_axes[axis];
        velocity_axes[axis] +=
            (int32_t)((int64_t)acceleration_axes[axis] * elapsed_ms / 1000);
    }

    state->timestamp_ms = timestamp_ms;
    return displacement_mm;
}

// Listener: runs in publisher context.
static void display_listener_cb(struct zbus_channel const* chan) {
    struct sensor_data const* msg = (struct sensor_data const*)zbus_chan_const_msg(chan);
    LOG_INF("[DISPLAY] seq=%u accel=(%d, %d, %d) mm/s2",
            msg->seq,
            msg->acceleration_mms2.x,
            msg->acceleration_mms2.y,
            msg->acceleration_mms2.z);
}

ZBUS_LISTENER_DEFINE(display_listener, display_listener_cb);

// Message subscriber: receives message copies, not only channel notifications.
ZBUS_MSG_SUBSCRIBER_DEFINE(logger_sub);

// Channel
ZBUS_CHAN_DEFINE(sensor_chan, struct sensor_data,
                 NULL, NULL,
                 ZBUS_OBSERVERS(display_listener, logger_sub),
                 ZBUS_MSG_INIT(.acceleration_mms2 = {0, 0, 0},
                               .timestamp_ms = 0,
                               .seq = 0));

// Publisher sensor thread
static void sensor_thread_fn(void* p1, void* p2, void* p3) {
    ARG_UNUSED(p1);
    ARG_UNUSED(p2);
    ARG_UNUSED(p3);

    for (uint8_t i = 0; i < SENSOR_COUNT; i++) {
        struct sensor_data data = {
            .acceleration_mms2 = {
                .x = 1000 + (i % 3) * 500,
                .y = (i % 2) ? -500 : 500,
                .z = 250,
            },
            .timestamp_ms = k_uptime_get_32(),
            .seq = i,
        };

        LOG_INF("[SENSOR] publish seq=%u accel=(%d, %d, %d) mm/s2",
                data.seq,
                data.acceleration_mms2.x,
                data.acceleration_mms2.y,
                data.acceleration_mms2.z);

        int ret = zbus_chan_pub(&sensor_chan, &data, K_MSEC(100));
        if (ret != 0) {
            LOG_WRN("[SENSOR] publish failed ret=%d", ret);
        }

        k_msleep(SENSOR_PERIOD_MS);
    }

    LOG_INF("[SENSOR] done");
}

static void logger_task_wdt_cb(int channel_id, void* user_data) {
    LOG_ERR("[LOGGER-WDT] callback triggered: channel=%d thread=%s",
            channel_id,
            k_thread_name_get((k_tid_t)user_data));
}

static void healthcheck_thread_fn(void* p1, void* p2, void* p3) {
    ARG_UNUSED(p1);
    ARG_UNUSED(p2);
    ARG_UNUSED(p3);

    LOG_INF("[QUEUE] healthcheck thread started");

    while (true) {
        uint32_t used_msgs = sys_sflist_len(&logger_sub.message_fifo->_queue.data_q);
        uint32_t fill_percent = (used_msgs * 100U) / CONFIG_ZBUS_MSG_SUBSCRIBER_NET_BUF_POOL_SIZE;

        LOG_INF("[QUEUE] fill=%u/%u (%u%%)", used_msgs, CONFIG_ZBUS_MSG_SUBSCRIBER_NET_BUF_POOL_SIZE, fill_percent);

        if (fill_percent >= HEALTHCHECK_WARNING_THRESHOLD_PERCENT) {
            LOG_WRN("[QUEUE] warning: backlog reached %u%%", fill_percent);
        }

        k_msleep(HEALTHCHECK_PERIOD_MS);
    }
}

// Message subscriber: logger thread
static void logger_thread_fn(void* p1, void* p2, void* p3) {
    ARG_UNUSED(p1);
    ARG_UNUSED(p2);
    ARG_UNUSED(p3);

    int logger_wdt_id = task_wdt_add(LOGGER_WDT_PERIOD_MS, logger_task_wdt_cb, (void*)k_current_get());
    if (logger_wdt_id < 0) {
        LOG_ERR("[LOGGER-WDT] failed to add task watchdog ret=%d", logger_wdt_id);
        return;
    }

    uint8_t received = 0;
    struct motion_state motion = {0};

    while (received < SENSOR_COUNT) {
        struct sensor_data msg;
        struct zbus_channel const* chan;
        int ret = zbus_sub_wait_msg(&logger_sub, &chan, &msg, K_MSEC(1500));
        if (ret != 0) {
            LOG_WRN("[LOGGER-MSG] timeout ret=%d", ret);
            break;
        }

        received++;

        struct vector3 displacement = integrate_motion(&motion, &msg.acceleration_mms2,
                                                       msg.timestamp_ms);

        LOG_INF("[LOGGER-MSG] seq=%u accel=(%d, %d, %d) displacement=%u mm "
                "position=%u mm speed=%u mm/s latency=%u ms",
                msg.seq,
                msg.acceleration_mms2.x,
                msg.acceleration_mms2.y,
                msg.acceleration_mms2.z,
                vector_magnitude(&displacement),
                vector_magnitude(&motion.position_mm),
                vector_magnitude(&motion.velocity_mms),
                k_uptime_get_32() - msg.timestamp_ms);

        task_wdt_feed(logger_wdt_id);

        // Simulate a consumer stall so the queue fills and the watchdog callback fires
        if (received == LOGGER_STALL_AFTER_RECEIVED) {
            LOG_WRN("[LOGGER-MSG] simulating stuck consumer after %d messages for %d ms",
                    LOGGER_STALL_AFTER_RECEIVED, LOGGER_STALL_MS);
            k_msleep(LOGGER_STALL_MS);
        }

        // Message copies are queued while the logger processes them more slowly.
        k_msleep(LOGGER_PERIOD_MS);
    }

    LOG_INF("[LOGGER-MSG] done received=%d", received);
}

K_THREAD_DEFINE(sensor_thread, STACK_SIZE, sensor_thread_fn, NULL, NULL, NULL, 5, 0, 0);
K_THREAD_DEFINE(logger_thread, STACK_SIZE, logger_thread_fn, NULL, NULL, NULL, 6, 0, 0);
K_THREAD_DEFINE(healthcheck_thread, STACK_SIZE, healthcheck_thread_fn, NULL, NULL, NULL, 4, 0, 0);

int main(void) {
    const struct device* hw_wdt_dev = DEVICE_DT_GET_OR_NULL(DT_ALIAS(watchdog0));
    int ret = task_wdt_init(hw_wdt_dev);

    if (ret != 0) {
        LOG_ERR("[MAIN] task_wdt_init failed ret=%d", ret);
        return 0;
    }

    LOG_INF("=== Zbus Example ===");
    LOG_INF("sensor publishes every %d ms", SENSOR_PERIOD_MS);
    LOG_INF("display listener runs in publisher context");
    LOG_INF("logger uses message subscriber copies");

    return 0;
}
```

## src/main_l6.c
```c
#include <zephyr/kernel.h>
#include <zephyr/logging/log.h>
#include <zephyr/tracing/tracing.h>

LOG_MODULE_REGISTER(homework, LOG_LEVEL_INF);

#define STACK_SIZE            2048
#define CONTROL_PRIORITY         4
#define MAINTENANCE_PRIORITY     7

#define EVENT_PERIOD_MS        250
#define MAINTENANCE_LOAD_US  45000
#define DEADLINE_MS             10

typedef struct control_event {
    uint32_t seq;
    uint32_t ready_ms;
} control_event;

K_MSGQ_DEFINE(control_queue, sizeof(control_event), 4, 4);
K_SEM_DEFINE(maintenance_start, 0, 1);

// Timer expiry: creates one control event
static void event_timer_expiry(struct k_timer* timer) {
    ARG_UNUSED(timer);

    static uint32_t seq = 0;
    control_event event = {
        .seq = seq++,
        .ready_ms = k_uptime_get_32(),
    };

    // Timer expiry runs in interrupt context, so never wait here.
    int ret = k_msgq_put(&control_queue, &event, K_NO_WAIT);

    if (ret != 0) {
        return;
    }

    // Both threads become ready when the timer interrupt returns.
    k_sem_give(&maintenance_start);
    sys_trace_named_event("event_ready", event.seq, k_msgq_num_used_get(&control_queue));
}

K_TIMER_DEFINE(event_timer, event_timer_expiry, NULL);

// Control thread
static void control_fn(void* p1, void* p2, void* p3) {
    ARG_UNUSED(p1); ARG_UNUSED(p2); ARG_UNUSED(p3);

    uint32_t deadline_misses = 0;

    while (true) {
        control_event event;
        int ret = k_msgq_get(&control_queue, &event, K_FOREVER);

        if (ret != 0) {
            LOG_ERR("[CONTROL] receive failed: %d", ret);
            continue;
        }

        uint32_t latency_ms = k_uptime_get_32() - event.ready_ms;
        sys_trace_named_event("event_done", event.seq, latency_ms);

        if (latency_ms > DEADLINE_MS) {
            deadline_misses++;
            LOG_WRN("[CONTROL] deadline_miss count=%u seq=%u latency=%ums", deadline_misses, event.seq, latency_ms);
        } else {
            LOG_INF("[CONTROL] event_done seq=%u latency=%ums", event.seq, latency_ms);
        }
    }
}

//  Background maintenance thread
static void maintenance_fn(void* p1, void* p2, void* p3) {
    ARG_UNUSED(p1); ARG_UNUSED(p2); ARG_UNUSED(p3);

    while (true) {
        k_sem_take(&maintenance_start, K_FOREVER);

        // This work is important, but it has no short deadline.
        k_busy_wait(MAINTENANCE_LOAD_US);
    }
}

K_THREAD_DEFINE(control, STACK_SIZE, control_fn, NULL, NULL, NULL, CONTROL_PRIORITY, 0, 0);
K_THREAD_DEFINE(maintenance, STACK_SIZE, maintenance_fn, NULL, NULL, NULL, MAINTENANCE_PRIORITY, 0, 0);

int main() {
    LOG_INF("=== L6 Homework: Runtime Investigation ===");
    LOG_INF("Control work must start within %d ms", DEADLINE_MS);
    LOG_INF("Inspect, measure, trace, explain, and correct the delay");

    k_timer_start(&event_timer, K_MSEC(500), K_MSEC(EVENT_PERIOD_MS));
    return 0;
}
```

## src/parser.c
```c
#include <zephyr/kernel.h>
#include <stdlib.h>
#include <string.h>
#include "parser.h"

// Const, so it is in flash: readable by the parser with or without isolation.
static const char settings[][SETTING_SIZE] __aligned(16) = {
	"led=off",
	"interval=10",
	"mode=auto",
};

// Parses one command received from the network.
// Supported command: "get=<n>", returns setting number n.
void parse_command(const char* cmd) {
	if (strncmp(cmd, "get=", 4) == 0) {
		long index = strtol(cmd + 4, NULL, 10);
		char value[SETTING_SIZE];

		// Bug: the index comes from the packet and is not checked against the table size.
		memcpy(value, settings[index], sizeof(value));
		printk("parser: setting %ld = %.16s\n", index, value);
		return;
	}

	printk("parser: unknown command '%s'\n", cmd);
}

// Only used by main to simulate an attacker who knows the table's address. */
const void* parser_settings_addr() {
	return settings;
}
```

## src/parser.h
```c
#ifndef PARSER_H
#define PARSER_H

#define SETTING_SIZE 16

// Parses one command received from the network.
void parse_command(const char *cmd);

// Returns the address of the settings table.
const void* parser_settings_addr();

#endif
```
